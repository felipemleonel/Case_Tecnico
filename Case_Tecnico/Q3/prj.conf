## CMakeLists.txt
```
# SPDX-License-Identifier: Apache-2.0

cmake_minimum_required(VERSION 3.20.0)
find_package(Zephyr REQUIRED HINTS $ENV{ZEPHYR_BASE})
project(Q3)
target_sources(app PRIVATE
  src/main.c
  src/launch_system.c
  src/missile.c
  src/timeout_monitor.c
  src/communication.c
  src/timers.c
)
```

## sample.yaml
```
sample:
  name: Q3
```

## prj.conf
```kconfig
# Habilita o printk
CONFIG_PRINTK=y

# Habilita UART
CONFIG_SERIAL=y
CONFIG_UART_CONSOLE=y

# Permite múltiplas threads
CONFIG_MAIN_THREAD_PRIORITY=5
CONFIG_MAIN_STACK_SIZE=1024

# Habilita o print de float
CONFIG_FPU=y
CONFIG_CBPRINTF_FP_SUPPORT=y
```

## src/main.c
```c
#include <zephyr/kernel.h>
#include <zephyr/sys/printk.h>
#include "../inc/missile.h"
#include "../inc/launch_system.h"
#include "../inc/timeout_monitor.h"
#include "../inc/timers.h"
#include "../inc/communication.h"

/*Iniciando as tasks*/
K_THREAD_DEFINE(launch_system_id, 1024, launch_system, NULL, NULL, NULL, 5, 0, 0);
K_THREAD_DEFINE(missile_id, 1024, missile, NULL, NULL, NULL, 5, 0, 0);
K_THREAD_DEFINE(timeout_monitor_id, 1024, timeout_monitor, NULL, NULL, NULL, 5, 0, 0);

int main(void) {
    printk("Sistema iniciado\n");

    start_timers(); // Chamada de função do módulo de timers

    return 1;
}
```

## inc/communication.h
```c
#ifndef COMMUNICATION_H
#define COMMUNICATION_H

#include <zephyr/kernel.h>
#include <stdbool.h>
/*Canais onde a comunicação irá ocorrer*/
extern struct k_msgq S_M_channel_communication;//Canal onde o sistema de lançamento envia mensagens para o míssil
extern struct k_msgq M_S_channel_communication;//Canal onde o míssil envia mensagens para o sistema de lançamento
/*Semáforos*/
extern struct k_sem sem_test_connection;//Controla a frequência do teste de comunicação
extern struct k_sem sem_communication;//Controla a frequência da comunicação
extern struct k_sem sem_missile_init;//Indica lançamento do míssil
extern struct k_sem sem_communication_init;//Indica início da comunicação
/*Variáveis globais de controle*/
extern bool self_destruction;
extern bool connection_established;
/*Função para printar tempo e validar frequências*/
void print_time(void);
/*Funções de callback para os timers*/
/*Estão aqui pois se utilizam dos semáforos*/
void timer_expiry_handler_test_connection(struct k_timer *timer);
void timer_expiry_handler_communication(struct k_timer *timer);

#endif
```

## inc/launch_system.h
```c
#ifndef SYSTEM_LAUNCH_H
#define SYSTEM_LAUNCH_H

#include "communication.h"
/*Task que controla o sistema de lançamento*/
void launch_system(void *p1, void *p2, void *p3);

#endif
```

## inc/missile.h
```c
#ifndef MISSILE_H
#define MISSILE_H

#include "communication.h"
/*Task que controla o sistema de lançamento*/
void missile(void *p1, void *p2, void *p3);

#endif
```

## inc/timeout_monitor.h
```c
#ifndef TIMEOUT_MONITOR_H
#define TIMEOUT_MONITOR_H

#include "communication.h"
/*Task para assegurar que apos 3 segundo o míssil é autodestruido*/
void timeout_monitor(void *p1, void *p2, void *p3);

#endif
```

## inc/timers.h
```c
#ifndef TIMERS_H
#define TIMERS_H

#include "communication.h"
/*Função para da início aos timers*/
void start_timers(void);

#endif
```

## src/communication.c
```c
#include <zephyr/kernel.h>
#include <zephyr/sys/printk.h>

/*Fila de mensagens*/ 
K_MSGQ_DEFINE(S_M_channel_communication, sizeof(float), 11, 4);
K_MSGQ_DEFINE(M_S_channel_communication, sizeof(float), 11, 4);

/*Semáforos*/ 
K_SEM_DEFINE(sem_test_connection, 0, 1);
K_SEM_DEFINE(sem_communication, 0, 1);
K_SEM_DEFINE(sem_missile_init, 0, 2);

bool self_destruction = false;
bool connection_established = false;

void print_time(void) {
    int64_t uptime_ms = k_uptime_get();
    uint32_t ms = uptime_ms % 1000;
    uint32_t sec = (uptime_ms / 1000) % 60;
    uint32_t min = (uptime_ms / 60000) % 60;
    uint32_t hr = uptime_ms / 3600000;
    printk("Hora do sistema: %02u:%02u:%02u.%03u\n", hr, min, sec, ms);
}

/*Timer callbacks*/
void timer_expiry_handler_test_connection(struct k_timer *timer) {
    k_sem_give(&sem_test_connection);
}
void timer_expiry_handler_communication(struct k_timer *timer) {
    k_sem_give(&sem_communication);
}
```

## src/launch_system.c
```c
#include <zephyr/kernel.h>
#include <zephyr/sys/printk.h>
#include <string.h>
#include "../inc/launch_system.h"


void launch_system(void *p1, void *p2, void *p3) {
    printk("Missil lancado!\n");
    for (int i = 0; i<2; i++) k_sem_give(&sem_missile_init);
    k_sleep(K_MSEC(3500));
    
    const char conn[] = "conn";
    char response[4];

    /*Teste de conexão*/
    for (int i = 0; i < 6; i++) {
        k_sem_take(&sem_test_connection, K_FOREVER);
        if (!self_destruction) {
            if (k_msgq_put(&S_M_channel_communication, &conn, K_NO_WAIT) == 0) {
                printk("Tentativa %d: comando enviado.\n", i + 1);
            } else {
                printk("Fila cheia, descartando dado\n");
            }

            k_sleep(K_MSEC(10));

            while (k_msgq_get(&M_S_channel_communication, &response, K_NO_WAIT) == 0) {
                printk("Conexao estabelecida.\n");
                connection_established = true;
            }

            if (connection_established) break;
        }
    }
    /*Comunicação*/
    if (connection_established) {
        while (1) {
            k_sem_take(&sem_communication, K_FOREVER);
            printk("Enviando dados de guiagem.\n");
            //print_time();
        }
    }
}
```

## src/missile.c
```c
#include <zephyr/kernel.h>
#include <zephyr/sys/printk.h>
#include <stdlib.h>
#include <string.h>
#include "../inc/missile.h"

void missile(void *p1, void *p2, void *p3) {
    k_sem_take(&sem_missile_init, K_FOREVER);
    char received[4];
    char response[4] = "conn";

    k_sleep(K_MSEC(3500));

    /*Rotina de resposta*/
    while (!self_destruction) {
        if (k_msgq_get(&S_M_channel_communication, &received, K_NO_WAIT) == 0) {
            if ((rand() % 100) < 50) {//Definir aqui a probabilidade do míssil conseguir responder
                k_msgq_put(&M_S_channel_communication, &response, K_NO_WAIT);
            }
        }
    }
}
```

## src/timeout_monitor.c
```c
#include <zephyr/kernel.h>
#include <zephyr/sys/printk.h>
#include "../inc/timeout_monitor.h"

void timeout_monitor(void *p1, void *p2, void *p3) {
    k_sem_take(&sem_missile_init, K_FOREVER);
    k_sleep(K_MSEC(3500));//Espera o delay inicial do sistema de lançamento
    k_sleep(K_MSEC(3000));

    /*Mensagem de auto destruição*/
    if (!connection_established) {
        printk("Missil se autodestruiu.\n");
        self_destruction = true;
    }
}
```

## src/timers.c
```c
#include <zephyr/kernel.h>
#include "../inc/timers.h"


extern void timer_expiry_handler_test_connection(struct k_timer *timer);
extern void timer_expiry_handler_communication(struct k_timer *timer);

K_TIMER_DEFINE(timer_test_connection, timer_expiry_handler_test_connection, NULL);
K_TIMER_DEFINE(timer_communication, timer_expiry_handler_communication, NULL);

void start_timers(void) {
    float period_test_connection_ms = 1000.0f / 5;
    float period_communication_ms = 1000.0f / 1;

    k_timer_start(&timer_test_connection, K_NO_WAIT, K_MSEC((int)period_test_connection_ms));
    k_timer_start(&timer_communication, K_NO_WAIT, K_MSEC((int)period_communication_ms));
}
```
