## Case_Tecnico/build/Kconfig/arch/Kconfig
```kconfig
# Load Zephyr Arch Kconfig descriptions.
osource "C:/Users/55319/zephyrproject/zephyr/arch/rx/Kconfig"
osource "C:/Users/55319/zephyrproject/zephyr/arch/x86/Kconfig"
osource "C:/Users/55319/zephyrproject/zephyr/arch/xtensa/Kconfig"
osource "C:/Users/55319/zephyrproject/zephyr/arch/sparc/Kconfig"
osource "C:/Users/55319/zephyrproject/zephyr/arch/riscv/Kconfig"
osource "C:/Users/55319/zephyrproject/zephyr/arch/posix/Kconfig"
osource "C:/Users/55319/zephyrproject/zephyr/arch/mips/Kconfig"
osource "C:/Users/55319/zephyrproject/zephyr/arch/arm64/Kconfig"
osource "C:/Users/55319/zephyrproject/zephyr/arch/arm/Kconfig"
osource "C:/Users/55319/zephyrproject/zephyr/arch/arc/Kconfig"
```

## Case_Tecnico/build/Kconfig/boards/Kconfig
```kconfig
# Load Zephyr board Kconfig descriptions.
osource "C:/Users/55319/zephyrproject/zephyr/boards/qemu/xtensa/Kconfig"
```

## Case_Tecnico/build/Kconfig/boards/Kconfig.defconfig
```kconfig
# Load Zephyr board defconfig descriptions.
osource "C:/Users/55319/zephyrproject/zephyr/boards/qemu/cortex_m3/Kconfig.defconfig"
```

## Case_Tecnico/build/Kconfig/boards/Kconfig.qemu_cortex_m3
```kconfig
# Load board Kconfig descriptions.
osource "C:/Users/55319/zephyrproject/zephyr/boards/qemu/cortex_m3/Kconfig.qemu_cortex_m3"
```
